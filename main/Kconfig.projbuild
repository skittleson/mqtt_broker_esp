## main/Kconfig.projbuild
```kconfig
menu "MQTT Broker Configuration"

    config MQTT_BROKER_HOSTNAME
        string "Default network hostname"
        default "mqtt_broker"
        help
            Hostname advertised via DHCP and mDNS (<hostname>.local).
            Overridable at runtime via the web portal /settings page
            (saved to NVS key "hostname" in namespace "mqtt_cfg").
            Max 32 chars.

    config MQTT_BROKER_AP_IP
        string "WiFi AP IP address"
        default "192.168.25.1"
        help
            IP address of the ESP32 on the WiFi AP subnet.
            This is the gateway/portal address for connected devices.
            Can be overridden at runtime via the web portal (saved to NVS).

    config MQTT_BROKER_AP_NETMASK
        string "WiFi AP netmask"
        default "255.255.255.0"
        help
            Subnet mask for the WiFi AP network.

    config MQTT_BROKER_ETHERNET
        bool "Enable Ethernet (W5500 SPI)"
        default n
        help
            Enable W5500 SPI Ethernet interface. When enabled, the ESP32
            acts as a gateway between the Ethernet LAN and WiFi AP subnet.
            NAPT bridges the two networks so LAN devices can reach WiFi AP
            clients (e.g., Tasmota devices on the AP subnet).

            Requires a W5500 module wired to the configured SPI pins.

    if MQTT_BROKER_ETHERNET

        config ETH_SPI_HOST
            int "SPI host (2 = SPI2_HOST)"
            default 2
            range 1 3
            help
                SPI host peripheral. 2 = SPI2_HOST (default), 3 = SPI3_HOST.

        # Defaults below match the Waveshare ESP32-S3-ETH board
        # (W5500 on SPI2). See https://www.waveshare.com/wiki/ESP32-S3-ETH

        config ETH_SPI_MOSI
            int "W5500 MOSI GPIO"
            default 11
            help
                GPIO pin connected to W5500 MOSI.

        config ETH_SPI_MISO
            int "W5500 MISO GPIO"
            default 12
            help
                GPIO pin connected to W5500 MISO.

        config ETH_SPI_SCLK
            int "W5500 SCLK GPIO"
            default 13
            help
                GPIO pin connected to W5500 SCLK.

        config ETH_SPI_CS
            int "W5500 CS GPIO"
            default 14
            help
                GPIO pin connected to W5500 CS (chip select).

        config ETH_SPI_INT
            int "W5500 INT GPIO"
            default 10
            help
                GPIO pin connected to W5500 INT (interrupt).

        config ETH_SPI_RST
            int "W5500 RST GPIO (-1 for none)"
            default 9
            range -1 48
            help
                GPIO pin connected to W5500 hardware reset.
                Set to -1 if not wired.

        config ETH_SPI_CLOCK_MHZ
            int "SPI clock speed (MHz)"
            default 25
            range 1 40
            help
                SPI clock speed in MHz. W5500 supports up to 33 MHz;
                25 MHz is a safe default that matches Waveshare's
                ESPHome reference config.

    endif # MQTT_BROKER_ETHERNET

endmenu
```

## sdkconfig.defaults
```kconfig
# Target
CONFIG_IDF_TARGET="esp32s3"

# PSRAM - 8MB octal
CONFIG_SPIRAM=y
CONFIG_SPIRAM_MODE_OCT=y
CONFIG_SPIRAM_TRY_ALLOCATE_WIFI_LWIP=y

# lwIP - support 100+ concurrent connections
CONFIG_LWIP_MAX_SOCKETS=115
CONFIG_LWIP_MAX_ACTIVE_TCP=115
CONFIG_LWIP_MAX_LISTENING_TCP=16
CONFIG_LWIP_TCP_SND_BUF_DEFAULT=2920
CONFIG_LWIP_TCP_WND_DEFAULT=2920
CONFIG_LWIP_TCP_RECVMBOX_SIZE=32

# WiFi - need SoftAP support for fallback
CONFIG_ESP_WIFI_SOFTAP_SUPPORT=y

# Flash size - 16MB
CONFIG_ESPTOOLPY_FLASHSIZE_16MB=y

# Partition table - custom OTA layout
CONFIG_PARTITION_TABLE_CUSTOM=y
CONFIG_PARTITION_TABLE_CUSTOM_FILENAME="partitions.csv"

# Log level - INFO for release (set to DEBUG for development)
CONFIG_LOG_DEFAULT_LEVEL_INFO=y
CONFIG_LOG_MAXIMUM_LEVEL_INFO=y

# Console output via UART0 (GPIO43 TX, GPIO44 RX) AND USB-Serial/JTAG
CONFIG_ESP_CONSOLE_UART=y
CONFIG_ESP_CONSOLE_UART_NUM=0
CONFIG_ESP_CONSOLE_UART_BAUDRATE=115200
CONFIG_ESP_CONSOLE_USB_SERIAL_JTAG=y

# Ethernet W5500 (uncomment for boards with W5500 SPI Ethernet)
# When enabled, the ESP32 bridges Ethernet LAN <-> WiFi AP via NAPT.
# CONFIG_MQTT_BROKER_ETHERNET=y
# CONFIG_ETH_USE_SPI_ETHERNET=y
# CONFIG_ETH_SPI_ETHERNET_W5500=y

# NAPT / IP forwarding (required for Ethernet bridging)
# CONFIG_LWIP_IP_FORWARD=y
# CONFIG_LWIP_IPV4_NAPT=y
```

## sdkconfig.defaults.eth
```kconfig
# sdkconfig.defaults.eth — Overlay for boards with W5500 SPI Ethernet
#
# Usage:
#   cp sdkconfig.defaults.eth sdkconfig.defaults.local
#   cat sdkconfig.defaults sdkconfig.defaults.local > sdkconfig.combined
#   idf.py -D SDKCONFIG_DEFAULTS="sdkconfig.combined" reconfigure
#
# Or simply uncomment the Ethernet lines in sdkconfig.defaults directly.

# Enable W5500 Ethernet
CONFIG_MQTT_BROKER_ETHERNET=y
CONFIG_ETH_USE_SPI_ETHERNET=y
CONFIG_ETH_SPI_ETHERNET_W5500=y

# Enable IP forwarding + NAPT for Ethernet <-> WiFi AP bridging
CONFIG_LWIP_IP_FORWARD=y
CONFIG_LWIP_IPV4_NAPT=y
```
